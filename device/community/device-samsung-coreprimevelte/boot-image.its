## device/community/device-samsung-coreprimevelte/boot-image.its
```
/dts-v1/;

/ {
	description = "Samsung Galaxy Core Prime VE LTE FIT";
	#address-cells = <1>;

	images {
		kernel {
			description = "Kernel image";
			data = /incbin/("vmlinuz");
			type = "kernel";
			arch = "arm64";
			os = "linux";
			compression = "gzip";
			load = <0x1000000>;
			entry = <0x1000000>;
		};

		fdt {
			description = "Device tree";
			data = /incbin/("/boot/dtbs/marvell/mmp/pxa1908-samsung-coreprimevelte.dtb");
			type = "flat_dt";
			compression = "none";
		};

		initramfs {
			description = "Initramfs image";
			data = /incbin/("initramfs");
			type = "ramdisk";
			arch = "arm64";
			os = "linux";
			compression = "none";
		};
	};

	configurations {
		default = "standard";

		standard {
			description = "Normal boot";
			kernel = "kernel";
			fdt = "fdt";
			ramdisk = "initramfs";
		};
	};
};
```
